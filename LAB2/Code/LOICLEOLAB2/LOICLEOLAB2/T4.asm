;>>>>>>>>>>>>>>>>>>>>>>>>>>>>>>>>>>>>>>>>>>>>>>>>>>>>>>>>>>>
; 1DT301, Computer Technology I
; Date: 2016-09-15
; Author:
; Student name 1
; Student name 2
;
; Lab number: 1
; Title: How to use the PORTs. Digital input/output. Subroutine call.
;
; Hardware: STK600, CPU ATmega2560
;
; Function: Describe the function of the program, so that you can understand it,
; even if you're viewing this in a year from now!
;
; Input ports: Describe the function of used ports, for example on-board switches
; connected to PORTA.
;
; Output ports: Describe the function of used ports, for example on-board LEDs
; connected to PORTB.
;
; Subroutines: If applicable.
; Included files: m2560def.inc
;
; Other information:
;
; Changes in program: (Description and date)
;<<<<<<<<<<<<<<<<<<<<<<<<<<<<<<<<<<<<<<<<<<<<<<<<<<<<<<<<<<<
.include "m2560def.inc"
.equ INPUT= 1000

ldi r16, 0xFF ;setting up the data direction register port B
out DDRB, r16 ;Set port B as output

ldi r21, 0b11111111; inital LED state
out portB, r21
	mov r17, r21
	ldi r22, 0xFF
	ldi r23, 0b11111110
	RC_loop:
		out portB, r17
		rol r17
		CALL Delay
		cp r17, r22
		breq RC_light
	rjmp RC_loop

	RC_light:
		rol r17
		out portB, r17
		rjmp RC_loop

Delay:
	ldi r24, low(INPUT)
	ldi r25, high(INPUT)
	wait_milliseconds:
		call ms_delay
		sbiw r25:r24,1
		cpi r25, high(0)
		breq reset
	rjmp wait_milliseconds
reset:
RET




ms_delay:
	; Generated by delay loop calculator
	; at http://www.bretmulvey.com/avrdelay.html
	;
	; Delay 1 000 cycles
	; 1ms at 1 MHz

		ldi  r18, 2
		ldi  r19, 75
	L1: dec  r19
		brne L1
		dec  r18
		brne L1
		rjmp PC+1
RET